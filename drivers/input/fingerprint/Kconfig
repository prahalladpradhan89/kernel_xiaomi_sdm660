## drivers/input/fingerprint/Kconfig
```kconfig
 menu "Fingerprint Drivers"

config FINGERPRINT_GF3258
	tristate "goodix gf3258 fingerprint drvier support"
	help
	  say y here to enable goodix gf3258 fingerprint driver support!  

config FINGERPRINT_FPC1020
	tristate "FPC 1020 fingerprint drvier support"
	help
	  say y here to enable fpc fingerprint driver support!  


endmenu
```
